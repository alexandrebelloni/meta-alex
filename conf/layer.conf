## conf/layer.conf
```bitbake
# We have a conf and classes directory, add to BBPATH
BBPATH := "${BBPATH}:${LAYERDIR}"

BBFILES := "${BBFILES} ${LAYERDIR}/recipes*/*/*.bb ${LAYERDIR}/recipes*/*/*.bbappend"

BBFILE_COLLECTIONS += "alex"
BBFILE_PATTERN_alex := "^${LAYERDIR}/"
BBFILE_PRIORITY_alex= "5"

LICENSE_PATH += "${LAYERDIR}/common/licenses"
```
